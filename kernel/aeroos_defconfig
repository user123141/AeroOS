## kernel/aeroos_defconfig
```kconfig
BR2_x86_64=y
BR2_x86_64_generic=y
BR2_LINUX_KERNEL=y
BR2_LINUX_KERNEL_CUSTOM_VERSION=y
BR2_LINUX_KERNEL_CUSTOM_VERSION_VALUE="6.12"
BR2_LINUX_KERNEL_USE_DEFCONFIG=y
BR2_LINUX_KERNEL_DEFCONFIG="x86_64_defconfig"
BR2_LINUX_KERNEL_CONFIG_FRAGMENT_FILES="$(BR2_EXTERNAL)/kernel/virtio.fragment $(BR2_EXTERNAL)/kernel/aeroos.fragment"
BR2_TARGET_ROOTFS_INITRAMFS=y
BR2_TARGET_ROOTFS_CPIO=y
BR2_TARGET_ROOTFS_CPIO_GZIP=y
BR2_PACKAGE_BUSYBOX=y
BR2_PACKAGE_BUSYBOX_SHOW_OTHERS=y
BR2_PACKAGE_BASH=y
BR2_PACKAGE_COREUTILS=y
BR2_PACKAGE_PROCFS=y
BR2_PACKAGE_UTIL_LINUX=y
BR2_PACKAGE_IFUPDOWN_SCRIPTS=n
BR2_PACKAGE_SYSTEMD=n
BR2_PACKAGE_OPENSSH=n
BR2_PACKAGE_DROPBEAR=n
```
